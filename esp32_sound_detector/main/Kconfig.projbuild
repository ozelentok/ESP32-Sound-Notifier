## esp32_sound_detector/main/Kconfig.projbuild
```kconfig
menu "WiFi Connection"
    config ESP_WIFI_SSID
        string "WiFi SSID"
        default "ssid"
        help
            SSID - network name.

    config ESP_WIFI_PASSWORD
        string "WiFi Password"
        default "password"
        help
            WiFi password.
endmenu

menu "Sound Notification"
    config SOUND_NOTIFICATION_REMOTE_IP
        string "Notification Recipient Remote IP"
        default ""
        help
            Host IP to send UDP packet about sound detection to

    config SOUND_NOTIFICATION_REMOTE_PORT
        int "Notification Recipient Remote Port"
        default 12100
        help
            Port to send UDP packet about sound detection on

    config SOUND_NOTIFICATION_SECRET
        string "Notification Recipient Authentication Secret"
        default "SD"
        help
            Secret to filter out unreleated packets on recipient

endmenu
```
